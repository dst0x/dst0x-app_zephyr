## boards/weact/weact_stm32f412_core/Kconfig.weact_stm32f412_core
```kconfig
# SPDX-License-Identifier: Apache-2.0

config BOARD_WEACT_STM32F412_CORE
	select SOC_STM32F412RX
```

## boards/weact/weact_stm32f412_core/board.yml
```yaml
board:
  name: weact_stm32f412_core
  full_name: STM32F412 Core Board V1.1
  vendor: weact
  socs:
    - name: stm32f412rx
```
